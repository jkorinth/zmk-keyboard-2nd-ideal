/*
 * Copyright (c) 2026 J. Korinth <jnsk@tuta.io>
 *
 * SPDX-License-Identifier: GPL-3.0-or-later
 */

#include "2nd_ideal.dtsi"

&default_transform {
	col-offset = <5>;
};

&right_encoder {
	status = "okay";
};
