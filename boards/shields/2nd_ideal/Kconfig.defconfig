## boards/shields/2nd_ideal/Kconfig.defconfig
```kconfig
if SHIELD_2NDIDEAL_LEFT || SHIELD_2NDIDEAL_RIGHT

config ZMK_KEYBOARD_NAME
	default "2nd Ideal"

config GPIO
	default y

config I2C
	default y

config LED_STRIP
	default y

config SPI
	default y

config ZMK_RGB_UNDERGLOW
	default n

config ZMK_SPLIT
	default y

config ZMK_BLE
	default y

endif


if SHIELD_2NDIDEAL_LEFT

config ZMK_SPLIT_ROLE_CENTRAL
	default y

config ZMK_USB
	default y

config BT_PERIPHERAL
	default n

endif


if SHIELD_2NDIDEAL_RIGHT

config ZMK_USB
	default n

endif
```

## boards/shields/2nd_ideal/Kconfig.shield
```kconfig
# Copyright (c) 2026 J. Korinth <jnsk@tuta.io>
# SPDX-License-Identifier: GPL-3.0-or-later

config SHIELD_2NDIDEAL_LEFT
	def_bool $(shields_list_contains,2nd_ideal_left)

config SHIELD_2NDIDEAL_RIGHT
	def_bool $(shields_list_contains,2nd_ideal_right)
```

## boards/shields/2nd_ideal/boards/xiao_ble.conf
```kconfig
CONFIG_EC11=y
CONFIG_EC11_TRIGGER_GLOBAL_THREAD=y
CONFIG_FLASH=y
CONFIG_FLASH_MAP=y
CONFIG_GPIO_HOGS=y
CONFIG_GPIO_HOGS_INIT_PRIORITY=80
CONFIG_GPIO_PCA_SERIES=y
CONFIG_GPIO_PCA_SERIES_INTERRUPT=y
CONFIG_HEAP_MEM_POOL_SIZE=8192
CONFIG_NEWLIB_LIBC=y
CONFIG_NVS=y
CONFIG_PICOLIBC=n
CONFIG_SETTINGS_NVS=y
```
